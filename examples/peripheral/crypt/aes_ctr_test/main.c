#include <string.h>
#include <stdlib.h>
#include "ls_hal_crypt.h"
#include "platform.h"
#include "ls_soc_gpio.h"
#include "log.h"

void crypt_init(void)
{
    HAL_LSCRYPT_Init();
    HAL_LSCRYPT_SetRandFunc(rand);
}

uint8_t cnt[0x10] = {0xf0, 0xf1, 0xf2, 0xf3, 0xf4, 0xf5, 0xf6, 0xf7, 0xf8, 0xf9, 0xfa, 0xfb, 0xfc, 0xfd, 0xfe, 0xff};

uint8_t ctr_plaintext[] = {
    //Block #1
    0x6b, 0xc1, 0xbe, 0xe2, 0x2e, 0x40, 0x9f, 0x96, 0xe9, 0x3d, 0x7e, 0x11, 0x73, 0x93, 0x17, 0x2a,
    //Block #2
    0xae, 0x2d, 0x8a, 0x57, 0x1e, 0x03, 0xac, 0x9c, 0x9e, 0xb7, 0x6f, 0xac, 0x45, 0xaf, 0x8e, 0x51,
    //Block #3
    0x30, 0xc8, 0x1c, 0x46, 0xa3, 0x5c, 0xe4, 0x11, 0xe5, 0xfb, 0xc1, 0x19, 0x1a, 0x0a, 0x52, 0xef,
    //Block #4
    0xf6, 0x9f, 0x24, 0x45, 0xdf, 0x4f, 0x9b, 0x17, 0xad, 0x2b, 0x41, 0x7b, 0xe6, 0x6c, 0x37, 0x10};

uint8_t ctr_ciphertext_128[] = {
    0x87, 0x4d, 0x61, 0x91, 0xb6, 0x20, 0xe3, 0x26, 0x1b, 0xef, 0x68, 0x64, 0x99, 0x0d, 0xb6, 0xce,
    0x98, 0x06, 0xf6, 0x6b, 0x79, 0x70, 0xfd, 0xff, 0x86, 0x17, 0x18, 0x7b, 0xb9, 0xff, 0xfd, 0xff,
    0x5a, 0xe4, 0xdf, 0x3e, 0xdb, 0xd5, 0xd3, 0x5e, 0x5b, 0x4f, 0x09, 0x02, 0x0d, 0xb0, 0x3e, 0xab,
    0x1e, 0x03, 0x1d, 0xda, 0x2f, 0xbe, 0x03, 0xd1, 0x79, 0x21, 0x70, 0xa0, 0xf3, 0x00, 0x9c, 0xee,
};

uint8_t ctr_ciphertext_192[] = {
    0x1a, 0xbc, 0x93, 0x24, 0x17, 0x52, 0x1c, 0xa2, 0x4f, 0x2b, 0x04, 0x59, 0xfe, 0x7e, 0x6e, 0x0b,
    0x09, 0x03, 0x39, 0xec, 0x0a, 0xa6, 0xfa, 0xef, 0xd5, 0xcc, 0xc2, 0xc6, 0xf4, 0xce, 0x8e, 0x94,
    0x1e, 0x36, 0xb2, 0x6b, 0xd1, 0xeb, 0xc6, 0x70, 0xd1, 0xbd, 0x1d, 0x66, 0x56, 0x20, 0xab, 0xf7,
    0x4f, 0x78, 0xa7, 0xf6, 0xd2, 0x98, 0x09, 0x58, 0x5a, 0x97, 0xda, 0xec, 0x58, 0xc6, 0xb0, 0x50,
};

uint8_t ctr_ciphertext_256[] = {
    0x60, 0x1e, 0xc3, 0x13, 0x77, 0x57, 0x89, 0xa5, 0xb7, 0xa7, 0xf5, 0x04, 0xbb, 0xf3, 0xd2, 0x28,
    0xf4, 0x43, 0xe3, 0xca, 0x4d, 0x62, 0xb5, 0x9a, 0xca, 0x84, 0xe9, 0x90, 0xca, 0xca, 0xf5, 0xc5,
    0x2b, 0x09, 0x30, 0xda, 0xa2, 0x3d, 0xe9, 0x4c, 0xe8, 0x70, 0x17, 0xba, 0x2d, 0x84, 0x98, 0x8d,
    0xdf, 0xc9, 0xc5, 0x8d, 0xb6, 0x7a, 0xad, 0xa6, 0x13, 0xc2, 0xdd, 0x08, 0x45, 0x79, 0x41, 0xa6,
};

/**buff**/
uint8_t ciphertext_buff[64];
uint8_t plaintext_buff[64];

uint32_t ctr_key_128[] = {
    0x09cf4f3c,
    0xabf71588,
    0x28aed2a6,
    0x2b7e1516};

uint32_t ctr_key_192[] = {
    0x522c6b7b,
    0x62f8ead2,
    0x809079e5,
    0xc810f32b,
    0xda0e6452,
    0x8e73b0f7};

uint32_t ctr_key_256[] = {
    0x0914dff4,
    0x2d9810a3,
    0x3b6108d7,
    0x1f352c07,
    0x857d7781,
    0x2b73aef0,
    0x15ca71be,
    0x603deb10};

void crypt_ctr_128(void)
{
    HAL_LSCRYPT_AES_Key_Config(ctr_key_128, AES_KEY_128);

    HAL_LSCRYPT_AES_CTR_Crypt(cnt, ctr_plaintext, sizeof(ctr_plaintext), ciphertext_buff);
    if (!(memcmp(ctr_ciphertext_128, ciphertext_buff, sizeof(ctr_ciphertext_128))))
    {
        LOG_I("CRYPT_CTR_ENCRYPT_128_TEST_SUCCESS!");
    }else
    {
        LOG_I("CRYPT_CTR_ENCRYPT_128_TEST_FAIL!");
    }

    HAL_LSCRYPT_AES_CTR_Crypt(cnt, ctr_ciphertext_128, sizeof(ctr_ciphertext_128), plaintext_buff);
    if (!(memcmp(ctr_plaintext, plaintext_buff, sizeof(ctr_plaintext))))
    {
        LOG_I("CRYPT_CTR_DECRYPT_128_TEST_SUCCESS!");
    }else
    {
        LOG_I("CRYPT_CTR_DECRYPT_128_TEST_FAIL!");
    }
}

void crypt_ctr_192(void)
{
    HAL_LSCRYPT_AES_Key_Config(ctr_key_192, AES_KEY_192);

    HAL_LSCRYPT_AES_CTR_Crypt(cnt, ctr_plaintext, sizeof(ctr_plaintext), ciphertext_buff);
    if (!(memcmp(ctr_ciphertext_192, ciphertext_buff, sizeof(ctr_ciphertext_192))))
    {
        LOG_I("CRYPT_CTR_ENCRYPT_192_TEST_SUCCESS!");
    }else
    {
        LOG_I("CRYPT_CTR_ENCRYPT_192_TEST_FAIL!");
    }

    HAL_LSCRYPT_AES_CTR_Crypt(cnt, ctr_ciphertext_192, sizeof(ctr_ciphertext_192), plaintext_buff);
    if (!(memcmp(ctr_plaintext, plaintext_buff, sizeof(ctr_plaintext))))
    {
        LOG_I("CRYPT_CTR_DECRYPT_192_TEST_SUCCESS!");
    }else
    {
        LOG_I("CRYPT_CTR_DECRYPT_192_TEST_FAIL!");
    }
}

void crypt_ctr_256(void)
{
    HAL_LSCRYPT_AES_Key_Config(ctr_key_256, AES_KEY_256);

    HAL_LSCRYPT_AES_CTR_Crypt(cnt, ctr_plaintext, sizeof(ctr_plaintext), ciphertext_buff);
    if (!(memcmp(ctr_ciphertext_256, ciphertext_buff, sizeof(ctr_ciphertext_256))))
    {
        LOG_I("CRYPT_CTR_ENCRYPT_256_TEST_SUCCESS!");
    }else
    {
        LOG_I("CRYPT_CTR_ENCRYPT_256_TEST_FAIL!");
    }

    HAL_LSCRYPT_AES_CTR_Crypt(cnt, ctr_ciphertext_256, sizeof(ctr_ciphertext_256), plaintext_buff);
    if (!(memcmp(ctr_plaintext, plaintext_buff, sizeof(ctr_plaintext))))
    {
        LOG_I("CRYPT_CTR_DECRYPT_256_TEST_SUCCESS!");
    }else
    {
        LOG_I("CRYPT_CTR_DECRYPT_256_TEST_FAIL!");
    }
}

void crypt_ctr_test(void)
{
    HAL_LSCRYPT_Block_Padding_Mode_Set(Padding_None);
    crypt_ctr_128();
    crypt_ctr_192();
    crypt_ctr_256();

}

int main()
{
    sys_init_none();
    crypt_init();
    crypt_ctr_test();
    while (1)
    {
    }
}
